## configs/eboda_basic_defconfig
```kconfig
BR2_mipsel=y
BR2_TOOLCHAIN_EXTERNAL=y
BR2_TOOLCHAIN_EXTERNAL_CUSTOM=y
BR2_TOOLCHAIN_EXTERNAL_DO_NOT_STRIP_PTHREAD_LIB=y
BR2_TOOLCHAIN_EXTERNAL_PATH="$(TOPDIR)/toolchain_mipsel"
BR2_TOOLCHAIN_EXTERNAL_LARGEFILE=y
BR2_TOOLCHAIN_EXTERNAL_WCHAR=y
# BR2_TOOLCHAIN_EXTERNAL_HAS_THREADS_NPTL is not set
BR2_TOOLCHAIN_EXTERNAL_CXX=y
BR2_TARGET_GENERIC_PASSWD_DES=y
BR2_ROOTFS_DEVICE_CREATION_STATIC=y
BR2_ROOTFS_SKELETON_CUSTOM=y
BR2_ROOTFS_SKELETON_CUSTOM_PATH="fs/cb3pp"
BR2_LINUX_KERNEL=y
BR2_LINUX_KERNEL_CUSTOM_TARBALL=y
BR2_LINUX_KERNEL_CUSTOM_TARBALL_LOCATION="scp://localhost:kernel/linux-2.6.12.314723.tgz"
BR2_LINUX_KERNEL_PATCH="kernel/OPlayAir_V1_28_GPL/patches"
BR2_LINUX_KERNEL_USE_CUSTOM_CONFIG=y
BR2_LINUX_KERNEL_CUSTOM_CONFIG_FILE="kernel/OPlayAir_V1_28_GPL/config.develop.avhdd.mars.old"
BR2_PACKAGE_BUSYBOX_CONFIG="package/busybox/busybox-1.22.x.config.openrtd"
BR2_TARGET_ROOTFS_RTDIMG=y
BR2_TARGET_ROOTFS_RTDIMG_PLAYER_CUSTOM_FW_PATH="$(TOPDIR)/firmware/hd500mini/install.img"
```
